## arch/arm/Kconfig.rej
```kconfig
***************
*** 1299,1304 ****
  
  source "drivers/pcmcia/Kconfig"
  
  endmenu
  
  menu "Kernel Features"
--- 1299,1318 ----
  
  source "drivers/pcmcia/Kconfig"
  
+ config ARM_ERRATA_764369
+ 	bool "ARM errata: Data cache line maintenance operation by MVA may not succeed"
+ 	depends on CPU_V7 && SMP
+ 	help
+ 	  This option enables the workaround for erratum 764369
+ 	  affecting Cortex-A9 MPCore with two or more processors (all
+ 	  current revisions). Under certain timing circumstances, a data
+ 	  cache line maintenance operation by MVA targeting an Inner
+ 	  Shareable memory region may fail to proceed up to either the
+ 	  Point of Coherency or to the Point of Unification of the
+ 	  system. This workaround adds a DSB instruction before the
+ 	  relevant cache maintenance functions and sets a specific bit
+ 	  in the diagnostic control register of the SCU.
+ 
  endmenu
  
  menu "Kernel Features"
```

## arch/sparc/Kconfig.rej
```kconfig
***************
*** 53,58 ****
  	select HAVE_PERF_EVENTS
  	select PERF_USE_VMALLOC
  	select IRQ_PREFLOW_FASTEOI
  
  config ARCH_DEFCONFIG
  	string
--- 53,59 ----
  	select HAVE_PERF_EVENTS
  	select PERF_USE_VMALLOC
  	select IRQ_PREFLOW_FASTEOI
+ 	select HAVE_C_RECORDMCOUNT
  
  config ARCH_DEFCONFIG
  	string
```
